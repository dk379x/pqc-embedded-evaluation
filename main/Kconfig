## main/Kconfig
```kconfig
menu "PQC Benchmarks"

config PQC_RUN_MLKEM
    bool "Run ML-KEM benchmark"
    default y

    choice MLKEM_SECURITY_LEVEL
        prompt "ML-KEM security level"
        default MLKEM_LEVEL_768
        depends on PQC_RUN_MLKEM

        config MLKEM_LEVEL_512
            bool "NIST Level 1 (ML-KEM-512)"

        config MLKEM_LEVEL_768
            bool "NIST Level 3 (ML-KEM-768)"

        config MLKEM_LEVEL_1024
            bool "NIST Level 5 (ML-KEM-1024)"
    endchoice

config PQC_RUN_MLDSA
    bool "Run ML-DSA benchmark"
    default n

config PQC_RUN_SLHDSA
    bool "Run SLH-DSA benchmark"
    default n

config PQC_WARMUP_ITERS
    int "Warm-up iterations"
    default 5

config PQC_RUN_ITERS
    int "Measured iterations (N)"
    default 100

config PQC_LOG_CSV
    bool "Log CSV output"
    default y

config PQC_LOG_VISUAL
    bool "Log human-readable output"
    default y

config PQC_LOG_EVERY
    int "Log every N runs"
    default 1

endmenu

menu "Power Measurement"

    choice POWER_MEASUREMENT
        prompt "Measurement mode"
        default POWER_MODE_IDLE

        config POWER_MODE_IDLE
            bool "Idle"

        config POWER_MODE_EMPTY_CONTROL
            bool "Empty Control Window"

        config POWER_MODE_MLKEM
            bool "ML-KEM operation"
    endchoice

    choice POWER_MLKEM_OPERATION
        prompt "ML-KEM operation"
        default POWER_MLKEM_ENCAP
        depends on POWER_MODE_MLKEM

        config POWER_MLKEM_KEYGEN
            bool "Keygen"

        config POWER_MLKEM_ENCAP
            bool "Encap"

        config POWER_MLKEM_DECAP
            bool "Decap"
    endchoice

endmenu
```
